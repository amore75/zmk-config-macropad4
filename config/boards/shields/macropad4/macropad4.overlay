#include <dt-bindings/zmk/matrix_transform.h>

/ {
    chosen {
        zmk,kscan = &kscan0;
        zmk,matrix_transform = &default_transform;
    };

    default_transform: keymap_transform_0 {
        compatible = "zmk,matrix-transform";
        rows = <1>;
        columns = <4>;
        map = <RC(0,0) RC(0,1) RC(0,2) RC(0,3)>;
    };

    kscan0: kscan_0 {
        compatible = "zmk,kscan-gpio-direct";
        wakeup-source;
        input-gpios =
            <&gpio0 11 (GPIO_ACTIVE_LOW | GPIO_PULL_UP)>,
            <&gpio1 6 (GPIO_ACTIVE_LOW | GPIO_PULL_UP)>,
            <&gpio1 0 (GPIO_ACTIVE_LOW | GPIO_PULL_UP)>,
            <&gpio1 4 (GPIO_ACTIVE_LOW | GPIO_PULL_UP)>;
    };
};
